## src/file/ch02-02/config2/Kconfig
```kconfig
mainmenu "test program"

comment "this is a $(FMWARE_VESRION) program test"

# 多级菜单
# layer-1
#   this is layer-1 test
#   layer-2
#     this is layer-2 test 
menu "layer-1"
	comment "this is layer-1 test"
	menu "layer-2"
		comment "this is layer-2 test"
	endmenu
endmenu

menuconfig SHOW_OPTIONS
    bool "show options"
    default "y"
    help
        this is for menu option test.

if SHOW_OPTIONS
  	menu "layer-3"
		comment "this is layer-3 test"
	endmenu  
endif

# config定义tristate类型控制项
config USER_OPTIONS_1
	tristate "tristate type"
	default "m"
	help
		this is for config option test.

# config定义string类型控制项
config USER_OPTIONS_2
	string "string type"
	default "USER_OPTIONS_2 string"
	help
		this is for config option test.

choice
	prompt "debug test choose"
	default USER_OPTIONS_2     

config DEBUG_TEST1
	bool "debug test1"
	help
	  This enables support for debug test 1.

config DEBUG_TEST2
	bool "debug test2"
	help
	  This enables support for debug test 2.

endchoice

config USER_OPTIONS_3
	bool "USER_OPTIONS_3 type"
	default "y"

config USER_OPTIONS_4
	bool "USER_OPTIONS_4 type"
	select USER_OPTIONS_3
	default "y"

config USER_OPTIONS_5
	string "USER_OPTIONS_5 string type"
	prompt "prompt string type"
	depends on USER_OPTIONS_3 && USER_OPTIONS_4
	default "USER_OPTIONS_5 string"
	help
		"USER_OPTIONS_5 string type"
```

## src/file/ch02-02/config3/Kconfig
```kconfig
#
# main menuconfig
#
mainmenu "gcc project"

comment "gcc compiler"

source "files/Kconfig"
```

## src/file/ch02-02/config3/files/Kconfig
```kconfig
#
# files manage
#
menu "files manage"

config FILE1_COMPILER
    bool "file1 compiler"
    default "y"

config FILE2_COMPILER
    bool "file2 compiler"
    default "y"   

endmenu
```

## src/file/ch02-10/buildroot-patch/package/Config.in
```kconfig
config BR2_PACKAGE_HELLOWORLD
    bool "helloworld"
    help
      This is a demo to add local app.
```

## src/file/ch02/ch02-05/imx6ull_user_defconfig
```kconfig
# architecture
BR2_arm=y
BR2_cortex_a7=y
BR2_ARM_FPU_NEON_VFPV4=y

#
# Toolchain
#
BR2_TOOLCHAIN=y
BR2_TOOLCHAIN_USES_GLIBC=y
BR2_TOOLCHAIN_EXTERNAL=y
BR2_TOOLCHAIN_EXTERNAL_CUSTOM=y
BR2_TOOLCHAIN_EXTERNAL_PREINSTALLED=y
BR2_TOOLCHAIN_EXTERNAL_PATH="/usr/application/coding_git/remote_manage/sdk/support/arm/compiler"
BR2_TOOLCHAIN_EXTERNAL_GLIBC=y
BR2_PACKAGE_HAS_TOOLCHAIN_EXTERNAL=y
BR2_PACKAGE_PROVIDES_TOOLCHAIN_EXTERNAL="toolchain-external-custom"
BR2_TOOLCHAIN_EXTERNAL_PREFIX="arm-none-linux-gnueabihf"
BR2_TOOLCHAIN_EXTERNAL_BOOTLIN_ARCH_SUPPORTS=y
BR2_TOOLCHAIN_EXTERNAL_CUSTOM_PREFIX="arm-none-linux-gnueabihf"
BR2_TOOLCHAIN_EXTERNAL_GCC_11=y
BR2_TOOLCHAIN_EXTERNAL_HEADERS_4_20=y
BR2_TOOLCHAIN_EXTERNAL_CUSTOM_GLIBC=y
BR2_TOOLCHAIN_EXTERNAL_HAS_SSP=y
BR2_TOOLCHAIN_EXTERNAL_HAS_SSP_STRONG=y
BR2_TOOLCHAIN_EXTERNAL_CXX=y
BR2_TOOLCHAIN_EXTERNAL_FORTRAN=y
BR2_TOOLCHAIN_EXTERNAL_OPENMP=y
BR2_PACKAGE_HOST_GDB_ARCH_SUPPORTS=y

# system
BR2_TARGET_GENERIC_GETTY_PORT="ttymxc0"

# required tools to create the SD card image
BR2_PACKAGE_HOST_DOSFSTOOLS=y
BR2_PACKAGE_HOST_GENIMAGE=y
BR2_PACKAGE_HOST_MTOOLS=y

# filesystem / image
BR2_ROOTFS_POST_IMAGE_SCRIPT="board/freescale/common/imx/post-image.sh"
BR2_TARGET_ROOTFS_EXT2=y
BR2_TARGET_ROOTFS_EXT2_4=y

#
# System configuration
#
BR2_ROOTFS_SKELETON_DEFAULT=y

BR2_TARGET_GENERIC_HOSTNAME="freedom"
BR2_TARGET_GENERIC_ISSUE="Welcome to freedom"
BR2_TARGET_GENERIC_PASSWD_SHA256=y
BR2_TARGET_GENERIC_PASSWD_METHOD="sha-256"
BR2_INIT_BUSYBOX=y
BR2_ROOTFS_DEVICE_CREATION_DYNAMIC_DEVTMPFS=y
BR2_ROOTFS_DEVICE_TABLE="system/device_table.txt"
BR2_TARGET_ENABLE_ROOT_LOGIN=y
BR2_TARGET_GENERIC_ROOT_PASSWD="root"
BR2_SYSTEM_BIN_SH_BUSYBOX=y
```
